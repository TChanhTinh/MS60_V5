## boards/arm/ms60/Kconfig.board
```kconfig
# Copyright (c) 2024 Mysteryassss
# SPDX-License-Identifier: MIT

config BOARD_MS60
    bool "ms60"
    depends on SOC_NRF52840_QIAA
```

## boards/arm/ms60/Kconfig.defconfig
```kconfig
# Copyright (c) 2024 Mysteryassss
# SPDX-License-Identifier: MIT

if BOARD_DEOW

config ZMK_KEYBOARD_NAME
    default "Mystery_60_BLE"

if USB_DEVICE_STACK

config USB_NRFX
    default y

endif # USB_DEVICE_STACK

config BT_CTLR
    default BT

config ZMK_BLE
    default y

config ZMK_USB
    default y

endif #
```

## boards/arm/ms60/ms60_defconfig
```kconfig
# Copyright (c) 2024 Mysteryassss
# SPDX-License-Identifier: MIT

CONFIG_SOC_SERIES_NRF52X=y
CONFIG_SOC_NRF52840_QIAA=y
CONFIG_BOARD_MS60=y

# Enable MPU
CONFIG_ARM_MPU=y
CONFIG_PINCTRL=y

# enable GPIO
CONFIG_GPIO=y
CONFIG_USE_DT_CODE_PARTITION=y
CONFIG_BUILD_OUTPUT_UF2=y
CONFIG_MPU_ALLOW_FLASH_WRITE=y
CONFIG_NVS=y
CONFIG_SETTINGS_NVS=y
CONFIG_FLASH=y
CONFIG_FLASH_PAGE_LAYOUT=y
CONFIG_FLASH_MAP=y

# RGB
CONFIG_ZMK_RGB_UNDERGLOW=y
CONFIG_WS2812_STRIP=y
CONFIG_ZMK_RGB_UNDERGLOW_HUE_START=160
CONFIG_ZMK_RGB_UNDERGLOW_EFF_START=3
CONFIG_ZMK_RGB_UNDERGLOW_BRT_MIN=10
CONFIG_ZMK_RGB_UNDERGLOW_BRT_MAX=50

# Battery
CONFIG_ZMK_BATTERY_REPORTING=y
CONFIG_ZMK_BATTERY_REPORT_INTERVAL=60

# ZMK Studio lock
CONFIG_ZMK_STUDIO_LOCKING=n 

# Enable deep sleep support
CONFIG_ZMK_SLEEP=y
CONFIG_ZMK_RGB_UNDERGLOW_AUTO_OFF_IDLE=y
CONFIG_ZMK_PM_SOFT_OFF=y

# POLLING RATE ( 1ms )
CONFIG_USB_HID_POLL_INTERVAL_MS=1
CONFIG_ZMK_HID_REPORT_TYPE_NKRO=y

# Debounce 
CONFIG_ZMK_KSCAN_DEBOUNCE_PRESS_MS=0
CONFIG_ZMK_KSCAN_DEBOUNCE_RELEASE_MS=3
CONFIG_ZMK_KSCAN_EVENT_QUEUE_SIZE=10


# Enable external crystal
CONFIG_CLOCK_CONTROL_NRF=y
CONFIG_CLOCK_CONTROL_NRF_K32SRC_RC=y

# Enable 32kHz crystal ( không nên bật, phạm vi sóng BLE giảm và latency tăng )
CONFIG_CLOCK_CONTROL_NRF_K32SRC_XTAL=n
CONFIG_CLOCK_CONTROL_NRF_K32SRC_30PPM=n

# BLE signal 
CONFIG_ZMK_BLE_EXPERIMENTAL_CONN=y
CONFIG_BT_CTLR_TX_PWR_PLUS_8=y
CONFIG_BT_CTLR_PHY_2M=n # Support BLE 5.0
```

## config/boards/arm/ms60/Kconfig.defconfig
```kconfig
if BOARD_MS60

config ZMK_KEYBOARD_NAME
	default "Mystery_60V5"

if USB_DEVICE_STACK

config USB_NRFX
    default y

endif # USB_DEVICE_STACK

config BT_CTLR
	default BT

config ZMK_BLE
	default y

config ZMK_USB
	default y

endif # 
```
